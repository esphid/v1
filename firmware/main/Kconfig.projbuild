## firmware/main/Kconfig.projbuild
```kconfig
menu "ESPHID"
config ESPHID_FW_VARIANT
    string "Firmware variant"
    default "s3-n8"
config ESPHID_OTA_REPO
    string "GitHub owner/repository for OTA"
    default ""
config ESPHID_TAILSCALE
    bool "Build native Tailscale support"
    default y
config ESPHID_LED_GPIO
    int "WS2812 status LED GPIO (-1 disables)"
    range -1 48
    default -1
endmenu
```

## firmware/sdkconfig.defaults
```kconfig
CONFIG_IDF_TARGET="esp32s3"
CONFIG_ESP_DEFAULT_CPU_FREQ_MHZ_240=y
CONFIG_ESPTOOLPY_FLASHMODE_QIO=y
CONFIG_ESPTOOLPY_FLASHFREQ_80M=y
CONFIG_ESPTOOLPY_FLASHSIZE_8MB=y
CONFIG_COMPILER_OPTIMIZATION_PERF=y
CONFIG_FREERTOS_HZ=1000
CONFIG_PARTITION_TABLE_CUSTOM=y
CONFIG_PARTITION_TABLE_CUSTOM_FILENAME="partitions.csv"
CONFIG_BOOTLOADER_APP_ROLLBACK_ENABLE=y
CONFIG_ESP_CONSOLE_UART_DEFAULT=y
CONFIG_ESP_CONSOLE_SECONDARY_NONE=y
CONFIG_ESP_MAIN_TASK_STACK_SIZE=8192
CONFIG_ESP_WIFI_IRAM_OPT=y
CONFIG_ESP_WIFI_RX_IRAM_OPT=y
CONFIG_LWIP_IRAM_OPTIMIZATION=y
CONFIG_LWIP_TCPIP_TASK_AFFINITY_CPU0=y
CONFIG_ESP_WIFI_TASK_PINNED_TO_CORE_0=y
CONFIG_LWIP_MAX_SOCKETS=32
CONFIG_HTTPD_WS_SUPPORT=y
CONFIG_HTTPD_MAX_REQ_HDR_LEN=1024
CONFIG_HTTPD_MAX_URI_LEN=256
CONFIG_ESP_HTTPS_SERVER_ENABLE=y
CONFIG_MBEDTLS_CERTIFICATE_BUNDLE=y
CONFIG_MBEDTLS_CERTIFICATE_BUNDLE_DEFAULT_FULL=y
CONFIG_MBEDTLS_ECP_DP_SECP256R1_ENABLED=y
CONFIG_BT_ENABLED=y
CONFIG_BT_NIMBLE_ENABLED=y
CONFIG_BT_NIMBLE_MAX_CONNECTIONS=2
CONFIG_BT_NIMBLE_MAX_BONDS=8
CONFIG_BT_NIMBLE_ATT_PREFERRED_MTU=517
CONFIG_BT_NIMBLE_SM_SC=y
CONFIG_BT_NIMBLE_NVS_PERSIST=y
CONFIG_BT_NIMBLE_50_FEATURE_SUPPORT=y
CONFIG_BT_NIMBLE_LL_CFG_FEAT_LE_2M_PHY=y
CONFIG_TINYUSB_HID_COUNT=2
CONFIG_MQTT_PROTOCOL_311=y
CONFIG_MQTT_TRANSPORT_WEBSOCKET=y
CONFIG_MQTT_TRANSPORT_WEBSOCKET_SECURE=y
CONFIG_ESP_TASK_WDT_TIMEOUT_S=10
CONFIG_MBEDTLS_X509_CRT_WRITE_C=y
CONFIG_MBEDTLS_PEM_WRITE_C=y
CONFIG_ML_ENABLE_CONFIG_HTTPD=y
# CONFIG_ML_CONFIG_HTTPD is not set
CONFIG_ML_MAX_PEERS=4
CONFIG_ML_NVS_MAX_PEERS=16
CONFIG_ML_H2_BUFFER_SIZE_KB=64
# CONFIG_ML_ENABLE_CELLULAR is not set
CONFIG_MBEDTLS_X509_CREATE_C=y
CONFIG_MBEDTLS_PK_WRITE_C=y
CONFIG_BT_NIMBLE_SM_SC_ONLY=1
# CONFIG_BT_NIMBLE_SM_LEGACY is not set
CONFIG_MBEDTLS_CHACHA20_C=y
CONFIG_MBEDTLS_CHACHAPOLY_C=y
CONFIG_BT_NIMBLE_PINNED_TO_CORE_0=y
CONFIG_HTTPD_WS_PRE_HANDSHAKE_CB_SUPPORT=y
CONFIG_BT_NIMBLE_HOST_TASK_STACK_SIZE=8192
CONFIG_ESP_HTTPS_OTA_ALLOW_HTTP=y
# Events, RPC and GATT service-change CCCDs must persist for all eight bonds.
CONFIG_BT_NIMBLE_MAX_CCCDS=32
# All protocol and control-plane objects fit well below these stack-safe bounds.
CONFIG_CJSON_NESTING_LIMIT=16
CONFIG_CJSON_CIRCULAR_LIMIT=32

# Deliver queued WebSocket timeout/reply work reliably under control-mailbox load.
# Only workers/events/watchdog enqueue work; receive callbacks never wait here.
CONFIG_HTTPD_QUEUE_WORK_BLOCKING=y
```

## firmware/variants/s3-n8/sdkconfig.defaults
```kconfig
CONFIG_ESPHID_FW_VARIANT="s3-n8"
CONFIG_ESPTOOLPY_FLASHSIZE_8MB=y
# CONFIG_SPIRAM is not set
# CONFIG_ESPHID_TAILSCALE is not set
```

## firmware/variants/s3-n8r2/sdkconfig.defaults
```kconfig
CONFIG_ESPHID_FW_VARIANT="s3-n8r2"
CONFIG_ESPTOOLPY_FLASHSIZE_8MB=y
CONFIG_SPIRAM=y
CONFIG_SPIRAM_MODE_QUAD=y
CONFIG_SPIRAM_SPEED_80M=y
CONFIG_SPIRAM_USE_MALLOC=y
CONFIG_SPIRAM_MALLOC_RESERVE_INTERNAL=65536
```
